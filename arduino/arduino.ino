//========== LIBRARY
#include <Wire.h>
#include <Adafruit_SSD1306.h>
#include <Adafruit_GFX.h>

//========== OLED SETTING
#define OLED_WIDTH 128
#define OLED_HEIGHT 64
#define OLED_ADDR   0x3C
#define FRAME_DELAY (42)
#define FRAME_WIDTH (48)
#define FRAME_HEIGHT (48)
#define FRAME_COUNT (sizeof(setting) / sizeof(setting[0]))
Adafruit_SSD1306 display(OLED_WIDTH, OLED_HEIGHT);

//========== SAFE DISTANCE FOR SENSOR
#define SAFEDIS 25
//========== PIN
unsigned int EchoPin1 = 2;
unsigned int TrigPin1 = 3;
unsigned int EchoPin2 = 6;
unsigned int TrigPin2 = 7;
const int KeyPin1 = 8;
const int KeyPin2 = 9;
const int KeyPin3 = 10;
const int KeyPin4 = 11;

//========== GIF ARRAY
const byte PROGMEM sounds[][288] = {
  {0, 0, 0, 0, 0, 0, 0, 0, 0, 0, 0, 0, 0,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 0, 0},
  {0, 0, 0, 0, 0, 0, 0, 0, 0, 0, 0, 0, 0,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 0, 0},
  {0, 0, 0, 0, 0, 0, 0, 0, 0, 0, 0, 0, 0,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 0, 0},
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  {0, 0, 0, 0, 0, 0, 0, 0, 0, 0, 0, 0, 0,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 0, 0}
};
const byte PROGMEM setting[][288] = {
  {0, 0, 0, 0, 0, 0, 0, 0, 0, 0, 0, 0, 0,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 0, 0},
  {0, 0, 0, 0, 0, 0, 0, 0, 0, 0, 0, 0, 0,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 0, 0},
  {0, 0, 0, 0, 0, 0, 0, 0, 0, 0, 0, 0, 0,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 0, 0},
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  {0, 0, 0, 0, 0, 0, 0, 0, 0, 0, 0, 0, 0,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 0, 0}
};
int frame = 0;

//========== PIN SETTING
//===== SENSOR1
unsigned long Time_Echo_us_1 = 0;
unsigned long Len_mm_X100_1  = 0; //Len_mm_X100_1 = length*100
unsigned long Len_Integer_1 = 0; //
unsigned int Len_Fraction_1 = 0;
//===== SENSOR2
unsigned long Time_Echo_us_2 = 0;
unsigned long Len_mm_X100_2  = 0; //Len_mm_X100_2 = length*100
unsigned long Len_Integer_2 = 0; //
unsigned int Len_Fraction_2 = 0;

//====== KEY
int PinState1 = 0, PinState2 = 0, PinState3 = 0, PinState4 = 0 ;
int Before = 0;//JITTER
int inByte = 0;

//========== SETUP FUNCTION
void setup() {
  Serial.begin(115200);
  //PIN MODE
  pinMode(EchoPin1, INPUT);
  pinMode(TrigPin1, OUTPUT);
  pinMode(EchoPin2, INPUT);
  pinMode(TrigPin2, OUTPUT);
  pinMode(KeyPin1, INPUT);
  pinMode(KeyPin2, INPUT);
  pinMode(KeyPin3, INPUT);
  pinMode(KeyPin4, INPUT);
  //OLED
  display.begin(SSD1306_SWITCHCAPVCC, OLED_ADDR);
  //ESTABLISH CONTACT
  establishContact();
}
//========== LOOP FUNCTION
void loop() {
  //====== SENSOR: CALCULATE DISTANCE
  int distance_calculated = calculatDistance();

  //====== PIN
  PinState1 = digitalRead(KeyPin1);
  PinState2 = digitalRead(KeyPin2);
  PinState3 = digitalRead(KeyPin3);
  PinState4 = digitalRead(KeyPin4);

  //====== JITTER & PRINT TO SERIAL
  if ((PinState1 || PinState2 || PinState3 || PinState4) && Before == 0) {
    Serial.print(PinState1); Serial.print(",");
    Serial.print(PinState1); Serial.print(",");
    Serial.print(PinState2); Serial.print(",");
    Serial.print(PinState3); Serial.print(",");
    Serial.print(distance_calculated, DEC); Serial.print(",");
    Serial.print(PinState4); Serial.println(",");
    Before = !Before;

  } else if (!(PinState1 || PinState2 || PinState3 || PinState4) && Before == 1) {
    Serial.print(PinState1); Serial.print(",");
    Serial.print(PinState1); Serial.print(",");
    Serial.print(PinState2); Serial.print(",");
    Serial.print(PinState3); Serial.print(",");
    Serial.print(distance_calculated, DEC); Serial.print(",");
    Serial.print(PinState4); Serial.println(",");

    Before = !Before;
  }
  //====== OLED
  oledDisplay(distance_calculated);

}
void oledDisplay(int distance) {
  display.clearDisplay();

  //===== DISPLAY TEXT
  display.setTextSize(2);
  display.setTextColor(WHITE);
  display.setCursor(0, 0);
  display.println("Playing");

  //===== DISPLAY DISTANCE
  display.setTextSize(2);
  display.setCursor(85, 30);
  display.println(distance);

  //===== MUSIC GIF
  display.drawBitmap(0, 20, sounds[frame], FRAME_WIDTH, FRAME_HEIGHT, 1);
  display.display();
  frame = (frame + 1) % FRAME_COUNT;
  delay(FRAME_DELAY);


}
void establishContact() {
  while (Serial.available() <= 0) {
    Serial.println('L');   // send a capital L
    delay(300);
  }
}
int calculatDistance() {
  int result;
  
  //===== SENSOR1
  digitalWrite(TrigPin1, HIGH);
  delayMicroseconds(50);
  digitalWrite(TrigPin1, LOW);
  Time_Echo_us_1 = pulseIn(EchoPin1, HIGH);
  if ((Time_Echo_us_1 < 60000) && (Time_Echo_us_1 > 1))
  {
    Len_mm_X100_1 = (Time_Echo_us_1 * 34) / 2;
    Len_Integer_1 = Len_mm_X100_1 / 100;
    Len_Fraction_1 = Len_mm_X100_1 % 100;
  }

  //===== SENSOR2
  digitalWrite(TrigPin2, HIGH);
  delayMicroseconds(50);
  digitalWrite(TrigPin2, LOW);
  Time_Echo_us_2 = pulseIn(EchoPin2, HIGH);
  if ((Time_Echo_us_2 < 60000) && (Time_Echo_us_2 > 1))
  {
    Len_mm_X100_2 = (Time_Echo_us_2 * 34) / 2;
    Len_Integer_2 = Len_mm_X100_2 / 100;
    Len_Fraction_2 = Len_mm_X100_2 % 100;
  }
  
  //===== RESULT
  int x = Len_Integer_1 - SAFEDIS;
  int y = Len_Integer_2 - SAFEDIS;
  if (Len_Integer_1 < SAFEDIS) {
    x = 0;
  }
  if (Len_Integer_2 < SAFEDIS) {
    y = 0;
  }
  result = 14 * x / (x + y);
  return result;

}
